## prj.conf
```kconfig
CONFIG_NETWORKING=y
CONFIG_LOG=y
CONFIG_GPIO=y
CONFIG_LWM2M_LOG_LEVEL_DBG=y
CONFIG_TEST_RANDOM_GENERATOR=y
CONFIG_NET_IPV6=y
CONFIG_NET_IF_UNICAST_IPV6_ADDR_COUNT=3
CONFIG_NET_IF_MCAST_IPV6_ADDR_COUNT=2
CONFIG_NET_IPV4=y
CONFIG_NET_DHCPV4=n
CONFIG_NET_IF_UNICAST_IPV4_ADDR_COUNT=3
CONFIG_NET_IF_MCAST_IPV4_ADDR_COUNT=2
CONFIG_PRINTK=y
CONFIG_NET_PKT_RX_COUNT=10
CONFIG_NET_PKT_TX_COUNT=10
CONFIG_NET_BUF_RX_COUNT=10
CONFIG_NET_BUF_TX_COUNT=10
CONFIG_NET_MAX_CONTEXTS=5

CONFIG_NET_LOG=y

CONFIG_NET_CONFIG_NEED_IPV6=y
CONFIG_NET_CONFIG_NEED_IPV4=y
CONFIG_NET_CONFIG_SETTINGS=y

CONFIG_LWM2M=y
CONFIG_LWM2M_COAP_BLOCK_SIZE=512
CONFIG_LWM2M_IPSO_SUPPORT=y
CONFIG_LWM2M_IPSO_TEMP_SENSOR=y
CONFIG_LWM2M_IPSO_LIGHT_CONTROL=y
CONFIG_LWM2M_IPSO_TIMER=y
CONFIG_LWM2M_SHELL=y

CONFIG_NET_CONFIG_MY_IPV6_ADDR="2001:db8::1"
CONFIG_NET_CONFIG_PEER_IPV6_ADDR="2001:db8::2"
CONFIG_NET_CONFIG_MY_IPV4_ADDR="192.0.2.1"
CONFIG_NET_CONFIG_MY_IPV4_GW="192.0.2.2"

# Longer endpoint name might be returned in a registration reply
CONFIG_COAP_EXTENDED_OPTIONS_LEN=y
CONFIG_COAP_EXTENDED_OPTIONS_LEN_VALUE=40

# Data format and LwM2M Version
CONFIG_LWM2M_VERSION_1_1=y

# SenML CBOR - default
CONFIG_ZCBOR=y
CONFIG_LWM2M_RW_CBOR_SUPPORT=y
CONFIG_LWM2M_RW_SENML_CBOR_SUPPORT=y
CONFIG_LWM2M_RW_JSON_SUPPORT=y
CONFIG_LWM2M_RW_SENML_JSON_SUPPORT=y
CONFIG_ZCBOR_CANONICAL=y
```

## src/firmware_update.c
```c
/*
 * Copyright (c) 2022 Nordic Semiconductor
 *
 * SPDX-License-Identifier: Apache-2.0
 */

#define LOG_MODULE_NAME app_fw_update
#include <zephyr/logging/log.h>
LOG_MODULE_REGISTER(LOG_MODULE_NAME);

#include <zephyr/net/lwm2m.h>
#include "modules.h"

static uint8_t firmware_buf[64];

/* Array with supported PULL firmware update protocols */
static uint8_t supported_protocol[1];

static int firmware_update_cb(uint16_t obj_inst_id,
			      uint8_t *args, uint16_t args_len)
{
	LOG_DBG("UPDATE");

	/* TODO: kick off update process */

	/* If success, set the update result as RESULT_SUCCESS.
	 * In reality, it should be set at function lwm2m_setup()
	 */
	lwm2m_set_u8(&LWM2M_OBJ(5, 0, 3), STATE_IDLE);
	lwm2m_set_u8(&LWM2M_OBJ(5, 0, 5), RESULT_SUCCESS);
	return 0;
}

static void *firmware_get_buf(uint16_t obj_inst_id, uint16_t res_id,
			      uint16_t res_inst_id, size_t *data_len)
{
	*data_len = sizeof(firmware_buf);
	return firmware_buf;
}

static int firmware_download_cb(uint16_t obj_inst_id,
				uint16_t res_id, uint16_t res_inst_id,
				uint8_t *data, uint16_t data_len,
				bool last_block, size_t total_size, size_t offset)
{
	LOG_INF("FIRMWARE: DOWNLOAD");
	LOG_INF("Download Link: %s", data);
	return 0;
}

static int firmware_block_received_cb(uint16_t obj_inst_id, uint16_t res_id,
				      uint16_t res_inst_id, uint8_t *data,
				      uint16_t data_len, bool last_block,
				      size_t total_size, size_t offset)
{
	LOG_INF("FIRMWARE: BLOCK RECEIVED: offset:%zd len:%u last_block:%d",
		offset, data_len, last_block);
	return 0;
}

static int firmware_cancel_cb(const uint16_t obj_inst_id)
{
	LOG_INF("FIRMWARE: Update canceled");
	return 0;
}

void init_firmware_update(void)
{
	/* setup data buffer for block-wise transfer */
	lwm2m_register_pre_write_callback(&LWM2M_OBJ(5, 0, 0), firmware_get_buf);
	lwm2m_register_post_write_callback(&LWM2M_OBJ(5, 0, 1), firmware_download_cb);
	lwm2m_firmware_set_write_cb(firmware_block_received_cb);

	/* register cancel callback */
	lwm2m_firmware_set_cancel_cb(firmware_cancel_cb);

	if (IS_ENABLED(CONFIG_LWM2M_FIRMWARE_UPDATE_PULL_SUPPORT)) {
		lwm2m_create_res_inst(&LWM2M_OBJ(5, 0, 8, 0));
		lwm2m_set_res_buf(&LWM2M_OBJ(5, 0, 8, 0), &supported_protocol[0],
					 sizeof(supported_protocol[0]),
					 sizeof(supported_protocol[0]), 0);

		lwm2m_firmware_set_update_cb(firmware_update_cb);
	}
}
```
