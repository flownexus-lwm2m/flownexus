## west.yml
```yaml
# Copyright (c) 2021 Nordic Semiconductor ASA
# SPDX-License-Identifier: Apache-2.0

manifest:
  self:
    path: flownexus

  remotes:
    - name: eclipse-leshan
      url-base: https://github.com/eclipse-leshan/
    - name: zephyrproject-rtos
      url-base: https://github.com/zephyrproject-rtos

  projects:
    - name: leshan
      remote: eclipse-leshan
      revision: master
    - name: zephyr
      remote: zephyrproject-rtos
      repo-path: zephyr
      revision: main
      import: true
```
