## CMakeLists.txt
```
# SPDX-License-Identifier: Apache-2.0

cmake_minimum_required(VERSION 3.20.0)
find_package(Zephyr REQUIRED HINTS $ENV{ZEPHYR_BASE})
project(flownexus_client)

target_sources(app PRIVATE
	src/main.c
	src/device.c
	src/fota.c
	src/sensors.c
	src/shell.c
)
```

## Kconfig
```
# Copyright (c) 2023 Nordic Semiconductor ASA
# Copyright (c) 2026 Jonas Remmert
# SPDX-License-Identifier: Apache-2.0

mainmenu "Flownexus LwM2M Client"

config LWM2M_APP_ID
	string "LwM2M endpoint name"
	default "flownexus-client"
	help
	  Endpoint name used by autostart and as DTLS PSK identity.

config LWM2M_APP_SERVER
	string "LwM2M server URI"
	default "coaps://127.0.0.1:5684" if LWM2M_DTLS_SUPPORT
	default "coap://127.0.0.1:5683"
	help
	  Initial Security object server URI (0/0/0). "flownexus start"
	  can override it at runtime.

config LWM2M_APP_AUTOSTART
	bool "Start the RD client at boot"
	help
	  Register with CONFIG_LWM2M_APP_ID at boot. When disabled, start the
	  client with "flownexus start [endpoint]".

if LWM2M_DTLS_SUPPORT

config LWM2M_APP_PSK
	string "PSK as hex string"
	default "000102030405060708090a0b0c0d0e0f"

config LWM2M_APP_TLS_TAG
	int "TLS security tag"
	default 1

endif

source "Kconfig.zephyr"
```

## sample.yaml
```
sample:
  name: Flownexus LwM2M client
common:
  tags:
    - lwm2m
  platform_allow:
    - native_sim/native/64
  integration_platforms:
    - native_sim/native/64
tests:
  flownexus.client.shell:
    harness: shell
    extra_configs:
      - CONFIG_UART_NATIVE_PTY_0_ON_STDINOUT=y
  flownexus.client.dtls:
    build_only: true
    extra_args: EXTRA_CONF_FILE=overlay-dtls.conf
  flownexus.client.bootstrap:
    build_only: true
    extra_args: EXTRA_CONF_FILE=overlay-bootstrap.conf
  flownexus.client.queue:
    build_only: true
    extra_args: EXTRA_CONF_FILE=overlay-queue.conf
```

## prj.conf
```kconfig
# Networking
CONFIG_NETWORKING=y
CONFIG_NET_IPV4=y
CONFIG_NET_IPV6=n
CONFIG_NET_SOCKETS=y
CONFIG_NET_CONNECTION_MANAGER=y
CONFIG_TEST_RANDOM_GENERATOR=y

# LwM2M
CONFIG_LWM2M=y
CONFIG_LWM2M_VERSION_1_1=y
CONFIG_LWM2M_IPSO_SUPPORT=y
CONFIG_LWM2M_IPSO_TEMP_SENSOR=y
CONFIG_LWM2M_IPSO_HUMIDITY_SENSOR=y
CONFIG_LWM2M_RW_SENML_CBOR_SUPPORT=y
CONFIG_LWM2M_RW_SENML_CBOR_RECORDS=100
# Timestamped Send of cached values (lwm2m cache)
CONFIG_LWM2M_RESOURCE_DATA_CACHE_SUPPORT=y
CONFIG_LWM2M_COAP_BLOCK_TRANSFER=y
CONFIG_LWM2M_COAP_BLOCK_SIZE=512
CONFIG_LWM2M_COAP_ENCODE_BUFFER_SIZE=4096
CONFIG_ZCBOR=y
CONFIG_ZCBOR_CANONICAL=y

# Leshan may return a long registration location path
CONFIG_COAP_EXTENDED_OPTIONS_LEN=y
CONFIG_COAP_EXTENDED_OPTIONS_LEN_VALUE=40

# Shell: "lwm2m ..." drives the client, "flownexus ..." the app
CONFIG_SHELL=y
CONFIG_LWM2M_SHELL=y

CONFIG_LOG=y
CONFIG_CBPRINTF_FP_SUPPORT=y
CONFIG_MAIN_STACK_SIZE=4096
```

## overlay-dtls.conf
```kconfig
# DTLS with PSK and Connection ID, based on samples/net/lwm2m_client
CONFIG_LWM2M_DTLS_SUPPORT=y
CONFIG_LWM2M_DTLS_CID=y
CONFIG_LWM2M_PEER_PORT=5684
CONFIG_LWM2M_SECURITY_KEY_SIZE=32

CONFIG_MBEDTLS=y
CONFIG_MBEDTLS_SSL_PROTO_TLS1_2=y
CONFIG_MBEDTLS_SSL_DTLS_CONNECTION_ID=y
CONFIG_MBEDTLS_ENABLE_HEAP=y
CONFIG_MBEDTLS_HEAP_SIZE=8192
CONFIG_MBEDTLS_SSL_IN_CONTENT_LEN=1500
CONFIG_MBEDTLS_SSL_OUT_CONTENT_LEN=1500
CONFIG_PSA_WANT_ALG_CCM=y
CONFIG_MBEDTLS_CIPHERSUITE_TLS_PSK_WITH_AES_128_GCM_SHA256=y

CONFIG_NET_SOCKETS_SOCKOPT_TLS=y
CONFIG_NET_SOCKETS_TLS_MAX_CONTEXTS=4
CONFIG_NET_SOCKETS_ENABLE_DTLS=y
CONFIG_SYSTEM_WORKQUEUE_STACK_SIZE=2048
```

## boards/native_sim_native_64.conf
```kconfig
# Use host sockets (NSOS), so no TAP interface or root privileges are needed.
CONFIG_ETH_NATIVE_TAP=n
CONFIG_NET_DRIVERS=y
CONFIG_NET_SOCKETS_OFFLOAD=y
CONFIG_NET_NATIVE_OFFLOADED_SOCKETS=y
CONFIG_NET_NATIVE_OFFLOADED_SOCKETS_CONNECTIVITY_SIM=y
CONFIG_NET_IF_UNICAST_IPV4_ADDR_COUNT=8
# Log directly to stdout; the shell backend drops boot messages
# and would print every line twice next to the native backend.
CONFIG_SHELL_LOG_BACKEND=n
```

## boards/qemu_cortex_m3.conf
```kconfig
CONFIG_NET_L2_ETHERNET=y
CONFIG_ETH_DRIVER=y
CONFIG_ETH_STELLARIS=y
CONFIG_NET_QEMU_ETHERNET=y

CONFIG_DNS_RESOLVER=y
CONFIG_DNS_SERVER_IP_ADDRESSES=y
#CONFIG_DNS_SERVER1="192.0.2.2"
CONFIG_DNS_SERVER2="8.8.8.8"
CONFIG_LWM2M_DNS_SUPPORT=y
CONFIG_NET_CONFIG_MY_IPV4_GW="192.0.2.2"
```

## src/main.c
```c
/*
 * Copyright (c) 2017 Linaro Limited
 * Copyright (c) 2017-2019 Foundries.io
 * Copyright (c) 2026 Jonas Remmert
 *
 * SPDX-License-Identifier: Apache-2.0
 */

#include <zephyr/kernel.h>
#include <zephyr/logging/log.h>
#include <zephyr/net/conn_mgr_connectivity.h>
#include <zephyr/net/conn_mgr_monitor.h>
#include <zephyr/net/lwm2m.h>
#include <zephyr/net/net_if.h>
#include <zephyr/sys/util.h>

#include "app.h"

LOG_MODULE_REGISTER(app_main, LOG_LEVEL_INF);

#define L4_EVENT_MASK (NET_EVENT_L4_CONNECTED | NET_EVENT_L4_DISCONNECTED)

static struct lwm2m_ctx client_ctx;
static struct net_mgmt_event_callback l4_cb;

static void rd_client_event(struct lwm2m_ctx *client, enum lwm2m_rd_client_event event)
{
	switch (event) {
	case LWM2M_RD_CLIENT_EVENT_REGISTRATION_COMPLETE:
		LOG_INF("Registration complete");
		break;
	case LWM2M_RD_CLIENT_EVENT_REG_UPDATE_COMPLETE:
		LOG_INF("Registration update complete");
		break;
	case LWM2M_RD_CLIENT_EVENT_REGISTRATION_FAILURE:
		LOG_WRN("Registration failure");
		break;
	case LWM2M_RD_CLIENT_EVENT_DEREGISTER:
		LOG_INF("Deregistered");
		break;
	case LWM2M_RD_CLIENT_EVENT_DISCONNECT:
		LOG_INF("Disconnected");
		break;
	case LWM2M_RD_CLIENT_EVENT_NETWORK_ERROR:
		LOG_ERR("Network error");
		break;
	default:
		LOG_DBG("RD client event %d", event);
		break;
	}
}

static void observe_cb(enum lwm2m_observe_event event, struct lwm2m_obj_path *path,
		       void *user_data)
{
	char buf[LWM2M_MAX_PATH_STR_SIZE];

	switch (event) {
	case LWM2M_OBSERVE_EVENT_OBSERVER_ADDED:
		LOG_INF("Observer added for %s", lwm2m_path_log_buf(buf, path));
		break;
	case LWM2M_OBSERVE_EVENT_OBSERVER_REMOVED:
		LOG_INF("Observer removed for %s", lwm2m_path_log_buf(buf, path));
		break;
	case LWM2M_OBSERVE_EVENT_NOTIFY_TIMEOUT:
		LOG_INF("Notify timeout for %s, trying registration update",
			lwm2m_path_log_buf(buf, path));
		lwm2m_rd_client_update();
		break;
	default:
		break;
	}
}

static void l4_event_handler(struct net_mgmt_event_callback *cb, uint64_t event,
			     struct net_if *iface)
{
	if (event == NET_EVENT_L4_CONNECTED) {
		LOG_INF("Network up");
		lwm2m_engine_resume();
	} else if (event == NET_EVENT_L4_DISCONNECTED) {
		LOG_INF("Network down");
		lwm2m_engine_pause();
	}
}

int app_lwm2m_start(const char *endpoint)
{
	uint32_t flags = IS_ENABLED(CONFIG_LWM2M_RD_CLIENT_SUPPORT_BOOTSTRAP)
				 ? LWM2M_RD_CLIENT_FLAG_BOOTSTRAP
				 : 0;

	return lwm2m_rd_client_start(&client_ctx, endpoint, flags, rd_client_event, observe_cb);
}

static int security_obj_init(void)
{
	lwm2m_set_string(&LWM2M_OBJ(0, 0, 0), CONFIG_LWM2M_APP_SERVER);
	lwm2m_set_u8(&LWM2M_OBJ(0, 0, 2), IS_ENABLED(CONFIG_LWM2M_DTLS_SUPPORT) ? 0 : 3);

#if defined(CONFIG_LWM2M_DTLS_SUPPORT)
	char psk[1 + sizeof(CONFIG_LWM2M_APP_PSK) / 2];
	size_t len = hex2bin(CONFIG_LWM2M_APP_PSK, sizeof(CONFIG_LWM2M_APP_PSK) - 1, psk,
			     sizeof(psk));

	if (len == 0) {
		return -EINVAL;
	}
	lwm2m_set_string(&LWM2M_OBJ(0, 0, 3), CONFIG_LWM2M_APP_ID);
	lwm2m_set_opaque(&LWM2M_OBJ(0, 0, 5), psk, len);
#endif

#if defined(CONFIG_LWM2M_RD_CLIENT_SUPPORT_BOOTSTRAP)
	lwm2m_set_u8(&LWM2M_OBJ(0, 0, 1), 1);
	lwm2m_create_object_inst(&LWM2M_OBJ(0, 1));
#else
	lwm2m_set_u16(&LWM2M_OBJ(0, 0, 10), CONFIG_LWM2M_SERVER_DEFAULT_SSID);
	lwm2m_set_u16(&LWM2M_OBJ(1, 0, 0), CONFIG_LWM2M_SERVER_DEFAULT_SSID);
#endif
	return 0;
}

static int network_init(void)
{
	struct net_if *iface = net_if_get_default();
	int ret;

	if (iface == NULL) {
		return -ENODEV;
	}

	net_mgmt_init_event_callback(&l4_cb, l4_event_handler, L4_EVENT_MASK);
	net_mgmt_add_event_callback(&l4_cb);

	ret = net_if_up(iface);
	if (ret < 0 && ret != -EALREADY) {
		return ret;
	}

	return conn_mgr_if_connect(iface);
}

int main(void)
{
	int ret;

	ret = network_init();
	if (ret < 0) {
		LOG_ERR("Network init failed (%d)", ret);
		return ret;
	}

	ret = security_obj_init();
	if (ret == 0) {
		ret = device_obj_init();
	}
	if (ret == 0) {
		ret = sensors_obj_init();
	}
	if (ret == 0) {
		ret = fota_obj_init();
	}
	if (ret < 0) {
		LOG_ERR("LwM2M object setup failed (%d)", ret);
		return ret;
	}

#if defined(CONFIG_LWM2M_DTLS_SUPPORT)
	client_ctx.tls_tag = CONFIG_LWM2M_APP_TLS_TAG;
#endif

	if (IS_ENABLED(CONFIG_LWM2M_APP_AUTOSTART)) {
		ret = app_lwm2m_start(CONFIG_LWM2M_APP_ID);
		if (ret < 0) {
			LOG_ERR("RD client start failed (%d)", ret);
			return ret;
		}
	}

	LOG_INF("Client initialized");
	return 0;
}
```

## src/app.h
```c
/*
 * Copyright (c) 2026 Jonas Remmert
 *
 * SPDX-License-Identifier: Apache-2.0
 */

#ifndef FLOWNEXUS_APP_H_
#define FLOWNEXUS_APP_H_

#include <stdint.h>

int device_obj_init(void);
int sensors_obj_init(void);
int fota_obj_init(void);
int fota_set_state(uint8_t state);
int fota_set_result(uint8_t result);
int app_lwm2m_start(const char *endpoint);

#endif /* FLOWNEXUS_APP_H_ */
```

## src/device.c
```c
/*
 * Copyright (c) 2017 Linaro Limited
 * Copyright (c) 2017-2019 Foundries.io
 * Copyright (c) 2026 Jonas Remmert
 *
 * SPDX-License-Identifier: Apache-2.0
 */

#include <string.h>

#include <zephyr/logging/log.h>
#include <zephyr/net/lwm2m.h>

#include "app.h"

LOG_MODULE_REGISTER(app_device, LOG_LEVEL_INF);

#define MANUFACTURER "Zephyr"
#define MODEL_NUMBER "Flownexus Client"
#define SERIAL_NUMBER "345000123"
#define HARDWARE_VER "1.0.1"

static uint8_t bat_level = 95;
static uint8_t bat_status = LWM2M_DEVICE_BATTERY_STATUS_CHARGING;
static uint8_t pwr_src = LWM2M_DEVICE_PWR_SRC_TYPE_USB;
static int pwr_mv = 5000;
static int pwr_ma = 900;
static int mem_free = 15;
static int mem_total = 25;
static char utc_offset[16] = "+00:00";
static char firmware_ver[32] = "1.0";

static int reboot_cb(uint16_t obj_inst_id, uint8_t *args, uint16_t args_len)
{
	LOG_INF("execute 3/0/4 (reboot)");
	return 0;
}

static int factory_default_cb(uint16_t obj_inst_id, uint8_t *args, uint16_t args_len)
{
	LOG_INF("execute 3/0/5 (factory default)");
	return 0;
}

static int utc_offset_cb(uint16_t obj_inst_id, uint16_t res_id, uint16_t res_inst_id,
			 uint8_t *data, uint16_t data_len, bool last_block, size_t total_size,
			 size_t offset)
{
	LOG_INF("write 3/0/14=%.*s", data_len, (char *)data);
	return 0;
}

static void set_ro_string(const struct lwm2m_obj_path *path, const char *value, uint16_t len)
{
	lwm2m_set_res_buf(path, (void *)value, len, len, LWM2M_RES_DATA_FLAG_RO);
}

int device_obj_init(void)
{
	set_ro_string(&LWM2M_OBJ(3, 0, 0), MANUFACTURER, sizeof(MANUFACTURER));
	set_ro_string(&LWM2M_OBJ(3, 0, 1), MODEL_NUMBER, sizeof(MODEL_NUMBER));
	set_ro_string(&LWM2M_OBJ(3, 0, 2), SERIAL_NUMBER, sizeof(SERIAL_NUMBER));
	set_ro_string(&LWM2M_OBJ(3, 0, 17), CONFIG_BOARD, sizeof(CONFIG_BOARD));
	set_ro_string(&LWM2M_OBJ(3, 0, 18), HARDWARE_VER, sizeof(HARDWARE_VER));

	lwm2m_register_exec_callback(&LWM2M_OBJ(3, 0, 4), reboot_cb);
	lwm2m_register_exec_callback(&LWM2M_OBJ(3, 0, 5), factory_default_cb);

	lwm2m_create_res_inst(&LWM2M_OBJ(3, 0, 6, 0));
	lwm2m_set_res_buf(&LWM2M_OBJ(3, 0, 6, 0), &pwr_src, sizeof(pwr_src), sizeof(pwr_src), 0);
	lwm2m_create_res_inst(&LWM2M_OBJ(3, 0, 7, 0));
	lwm2m_set_res_buf(&LWM2M_OBJ(3, 0, 7, 0), &pwr_mv, sizeof(pwr_mv), sizeof(pwr_mv), 0);
	lwm2m_create_res_inst(&LWM2M_OBJ(3, 0, 8, 0));
	lwm2m_set_res_buf(&LWM2M_OBJ(3, 0, 8, 0), &pwr_ma, sizeof(pwr_ma), sizeof(pwr_ma), 0);

	lwm2m_set_res_buf(&LWM2M_OBJ(3, 0, 9), &bat_level, sizeof(bat_level), sizeof(bat_level), 0);
	lwm2m_set_res_buf(&LWM2M_OBJ(3, 0, 10), &mem_free, sizeof(mem_free), sizeof(mem_free), 0);
	lwm2m_set_res_buf(&LWM2M_OBJ(3, 0, 20), &bat_status, sizeof(bat_status),
			  sizeof(bat_status), 0);
	lwm2m_set_res_buf(&LWM2M_OBJ(3, 0, 21), &mem_total, sizeof(mem_total), sizeof(mem_total),
			  0);

	lwm2m_set_res_buf(&LWM2M_OBJ(3, 0, 3), firmware_ver, sizeof(firmware_ver),
			  strlen(firmware_ver) + 1, 0);
	lwm2m_set_res_buf(&LWM2M_OBJ(3, 0, 14), utc_offset, sizeof(utc_offset),
			  strlen(utc_offset) + 1, 0);
	return lwm2m_register_post_write_callback(&LWM2M_OBJ(3, 0, 14), utc_offset_cb);
}
```

## src/fota.c
```c
/*
 * Copyright (c) 2026 Jonas Remmert
 *
 * SPDX-License-Identifier: Apache-2.0
 */

#include <zephyr/kernel.h>
#include <zephyr/logging/log.h>
#include <zephyr/net/lwm2m.h>

#include "app.h"

LOG_MODULE_REGISTER(app_fota, LOG_LEVEL_INF);

static int report(bool with_result)
{
	struct lwm2m_ctx *ctx = lwm2m_rd_client_ctx();
	const struct lwm2m_obj_path paths[] = {
		LWM2M_OBJ(LWM2M_OBJECT_FIRMWARE_ID, 0, 3),
		LWM2M_OBJ(LWM2M_OBJECT_FIRMWARE_ID, 0, 5),
	};

	if (ctx == NULL) {
		return -ENOTCONN;
	}

	return lwm2m_send_cb(ctx, paths, with_result ? 2 : 1, NULL);
}

static void report_updating(struct k_work *work)
{
	int ret = report(false);

	if (ret < 0) {
		LOG_ERR("Cannot report update state (%d)", ret);
	}
}

static K_WORK_DEFINE(updating_work, report_updating);

static int package_uri_cb(uint16_t obj_inst_id, uint16_t res_id, uint16_t res_inst_id,
			  uint8_t *data, uint16_t data_len, bool last_block, size_t total_size,
			  size_t offset)
{
	LOG_INF("write 5/0/1=%.*s", data_len, (char *)data);
	return 0;
}

static int update_cb(uint16_t obj_inst_id, uint8_t *args, uint16_t args_len)
{
	LOG_INF("execute 5/0/2 (update)");
	k_work_submit(&updating_work);
	return 0;
}

int fota_set_state(uint8_t state)
{
	int ret = lwm2m_set_u8(&LWM2M_OBJ(LWM2M_OBJECT_FIRMWARE_ID, 0, 3), state);

	return ret < 0 ? ret : report(false);
}

int fota_set_result(uint8_t result)
{
	int ret = lwm2m_set_u8(&LWM2M_OBJ(LWM2M_OBJECT_FIRMWARE_ID, 0, 3), STATE_IDLE);

	if (ret == 0) {
		ret = lwm2m_set_u8(&LWM2M_OBJ(LWM2M_OBJECT_FIRMWARE_ID, 0, 5), result);
	}
	return ret < 0 ? ret : report(true);
}

int fota_obj_init(void)
{
	lwm2m_firmware_set_update_cb(update_cb);
	return lwm2m_register_post_write_callback(&LWM2M_OBJ(LWM2M_OBJECT_FIRMWARE_ID, 0, 1),
						  package_uri_cb);
}
```

## src/lwm2m-client.c
```c
/*
 * Copyright (c) 2017 Linaro Limited
 * Copyright (c) 2017-2019 Foundries.io
 *
 * SPDX-License-Identifier: Apache-2.0
 */

#define LOG_MODULE_NAME net_lwm2m_client_app
#define LOG_LEVEL LOG_LEVEL_INF

#include <zephyr/logging/log.h>
LOG_MODULE_REGISTER(LOG_MODULE_NAME, LOG_LEVEL);

#include <zephyr/drivers/hwinfo.h>
#include <zephyr/kernel.h>
#include <zephyr/drivers/gpio.h>
#include <zephyr/drivers/sensor.h>
#include <zephyr/net/lwm2m.h>
#include <zephyr/net/conn_mgr_monitor.h>
#include <zephyr/net/conn_mgr_connectivity.h>
#include <zephyr/net/wifi_mgmt.h>
#include "modules.h"
#include "lwm2m_resource_ids.h"

#define APP_BANNER "Run LWM2M client"

#define WAIT_TIME	K_SECONDS(10)
#define CONNECT_TIME	K_SECONDS(10)

#define CLIENT_MANUFACTURER	"Zephyr"
#define CLIENT_MODEL_NUMBER	"OMA-LWM2M Sample Client"
#define CLIENT_SERIAL_NUMBER	"345000123"
#define CLIENT_FIRMWARE_VER	"1.0"
#define CLIENT_HW_VER		"1.0.1"
#define TEMP_SENSOR_UNITS	"Celcius"

/* Macros used to subscribe to specific Zephyr NET management events. */
#define L4_EVENT_MASK (NET_EVENT_L4_CONNECTED | NET_EVENT_L4_DISCONNECTED)
#define CONN_LAYER_EVENT_MASK (NET_EVENT_CONN_IF_FATAL_ERROR)

static uint8_t bat_idx = LWM2M_DEVICE_PWR_SRC_TYPE_BAT_INT;
static int bat_mv = 3800;
static int bat_ma = 125;
static uint8_t usb_idx = LWM2M_DEVICE_PWR_SRC_TYPE_USB;
static int usb_mv = 5000;
static int usb_ma = 900;
static uint8_t bat_level = 95;
static uint8_t bat_status = LWM2M_DEVICE_BATTERY_STATUS_CHARGING;
static int mem_free = 15;
static int mem_total = 25;
static double min_range = 0.0;
static double max_range = 100;

struct lwm2m_ctx client_ctx = {0};

static const char *endpoint =
	(sizeof(CONFIG_LWM2M_APP_ID) > 1 ? CONFIG_LWM2M_APP_ID : CONFIG_BOARD);

#if defined(CONFIG_LWM2M_DTLS_SUPPORT)
BUILD_ASSERT(sizeof(endpoint) <= CONFIG_LWM2M_SECURITY_KEY_SIZE,
		"Client ID length is too long");
#endif /* CONFIG_LWM2M_DTLS_SUPPORT */

static struct k_sem quit_lock;

/* Zephyr NET management event callback structures. */
static struct net_mgmt_event_callback l4_cb;
static struct net_mgmt_event_callback conn_cb;
static struct net_mgmt_event_callback wifi_conn_cb;

#if defined(CONFIG_WIFI) && (CONFIG_WIFI == 1)
static struct wifi_connect_req_params cnx_params;
#endif

static K_SEM_DEFINE(network_connected_sem, 0, 1);

static int device_reboot_cb(uint16_t obj_inst_id,
			    uint8_t *args, uint16_t args_len)
{
	LOG_INF("DEVICE: REBOOT");
	/* Add an error for testing */
	lwm2m_device_add_err(LWM2M_DEVICE_ERROR_LOW_POWER);
	/* Change the battery voltage for testing */
	lwm2m_set_s32(&LWM2M_OBJ(3, 0, 7, 0), (bat_mv - 1));

	return 0;
}

static int device_factory_default_cb(uint16_t obj_inst_id,
				     uint8_t *args, uint16_t args_len)
{
	LOG_INF("DEVICE: FACTORY DEFAULT");
	/* Add an error for testing */
	lwm2m_device_add_err(LWM2M_DEVICE_ERROR_GPS_FAILURE);
	/* Change the USB current for testing */
	lwm2m_set_s32(&LWM2M_OBJ(3, 0, 8, 1), (usb_ma - 1));

	return 0;
}

static int lwm2m_setup(void)
{
	struct lwm2m_res_item temp_sensor_items[] = {
		{&LWM2M_OBJ(IPSO_OBJECT_TEMP_SENSOR_ID, 0, MIN_RANGE_VALUE_RID), &min_range,
		 sizeof(min_range)},
		{&LWM2M_OBJ(IPSO_OBJECT_TEMP_SENSOR_ID, 0, MAX_RANGE_VALUE_RID), &max_range,
		 sizeof(max_range)},
		{&LWM2M_OBJ(IPSO_OBJECT_TEMP_SENSOR_ID, 0, SENSOR_UNITS_RID), TEMP_SENSOR_UNITS,
		 sizeof(TEMP_SENSOR_UNITS)}
	};

	/* setup SECURITY object */

	/* Server URL */
	lwm2m_set_string(&LWM2M_OBJ(0, 0, 0), CONFIG_LWM2M_APP_SERVER);

	/* Security Mode */
	lwm2m_set_u8(&LWM2M_OBJ(0, 0, 2), IS_ENABLED(CONFIG_LWM2M_DTLS_SUPPORT) ? 0 : 3);
#if defined(CONFIG_LWM2M_DTLS_SUPPORT)
	lwm2m_set_string(&LWM2M_OBJ(0, 0, 3), endpoint);
	if (sizeof(CONFIG_LWM2M_APP_PSK) > 1) {
		char psk[1 + sizeof(CONFIG_LWM2M_APP_PSK) / 2];
		/* Need to skip the nul terminator from string */
		size_t len = hex2bin(CONFIG_LWM2M_APP_PSK, sizeof(CONFIG_LWM2M_APP_PSK) - 1, psk,
				     sizeof(psk));
		if (len <= 0) {
			return -EINVAL;
		}
		lwm2m_set_opaque(&LWM2M_OBJ(0, 0, 5), (void *)psk, len);
	}
#endif /* CONFIG_LWM2M_DTLS_SUPPORT */

#if defined(CONFIG_LWM2M_RD_CLIENT_SUPPORT_BOOTSTRAP)
	/* Mark 1st instance of security object as a bootstrap server */
	lwm2m_set_u8(&LWM2M_OBJ(0, 0, 1), 1);

	/* Create 2nd instance of security object needed for bootstrap */
	lwm2m_create_object_inst(&LWM2M_OBJ(0, 1));
#else
	/* Match Security object instance with a Server object instance with
	 * Short Server ID.
	 */
	lwm2m_set_u16(&LWM2M_OBJ(0, 0, 10), CONFIG_LWM2M_SERVER_DEFAULT_SSID);
	lwm2m_set_u16(&LWM2M_OBJ(1, 0, 0), CONFIG_LWM2M_SERVER_DEFAULT_SSID);
#endif

	/* setup SERVER object */

	/* setup DEVICE object */

	lwm2m_set_res_buf(&LWM2M_OBJ(3, 0, 0), CLIENT_MANUFACTURER, sizeof(CLIENT_MANUFACTURER),
			  sizeof(CLIENT_MANUFACTURER), LWM2M_RES_DATA_FLAG_RO);
	lwm2m_set_res_buf(&LWM2M_OBJ(3, 0, 1), CLIENT_MODEL_NUMBER, sizeof(CLIENT_MODEL_NUMBER),
			  sizeof(CLIENT_MODEL_NUMBER), LWM2M_RES_DATA_FLAG_RO);
	lwm2m_set_res_buf(&LWM2M_OBJ(3, 0, 2), CLIENT_SERIAL_NUMBER, sizeof(CLIENT_SERIAL_NUMBER),
			  sizeof(CLIENT_SERIAL_NUMBER), LWM2M_RES_DATA_FLAG_RO);
	lwm2m_set_res_buf(&LWM2M_OBJ(3, 0, 3), CLIENT_FIRMWARE_VER, sizeof(CLIENT_FIRMWARE_VER),
			  sizeof(CLIENT_FIRMWARE_VER), LWM2M_RES_DATA_FLAG_RO);
	lwm2m_register_exec_callback(&LWM2M_OBJ(3, 0, 4), device_reboot_cb);
	lwm2m_register_exec_callback(&LWM2M_OBJ(3, 0, 5), device_factory_default_cb);
	lwm2m_set_res_buf(&LWM2M_OBJ(3, 0, 9), &bat_level, sizeof(bat_level), sizeof(bat_level), 0);
	lwm2m_set_res_buf(&LWM2M_OBJ(3, 0, 10), &mem_free, sizeof(mem_free), sizeof(mem_free), 0);
	lwm2m_set_res_buf(&LWM2M_OBJ(3, 0, 17), CONFIG_BOARD, sizeof(CONFIG_BOARD),
			  sizeof(CONFIG_BOARD), LWM2M_RES_DATA_FLAG_RO);
	lwm2m_set_res_buf(&LWM2M_OBJ(3, 0, 18), CLIENT_HW_VER, sizeof(CLIENT_HW_VER),
			  sizeof(CLIENT_HW_VER), LWM2M_RES_DATA_FLAG_RO);
	lwm2m_set_res_buf(&LWM2M_OBJ(3, 0, 20), &bat_status, sizeof(bat_status),
			  sizeof(bat_status), 0);
	lwm2m_set_res_buf(&LWM2M_OBJ(3, 0, 21), &mem_total, sizeof(mem_total),
			  sizeof(mem_total), 0);

	/* add power source resource instances */
	lwm2m_create_res_inst(&LWM2M_OBJ(3, 0, 6, 0));
	lwm2m_set_res_buf(&LWM2M_OBJ(3, 0, 6, 0), &bat_idx, sizeof(bat_idx), sizeof(bat_idx), 0);
	lwm2m_create_res_inst(&LWM2M_OBJ(3, 0, 7, 0));
	lwm2m_set_res_buf(&LWM2M_OBJ(3, 0, 7, 0), &bat_mv, sizeof(bat_mv), sizeof(bat_mv), 0);
	lwm2m_create_res_inst(&LWM2M_OBJ(3, 0, 8, 0));
	lwm2m_set_res_buf(&LWM2M_OBJ(3, 0, 8, 0), &bat_ma, sizeof(bat_ma), sizeof(bat_ma), 0);
	lwm2m_create_res_inst(&LWM2M_OBJ(3, 0, 6, 1));
	lwm2m_set_res_buf(&LWM2M_OBJ(3, 0, 6, 1), &usb_idx, sizeof(usb_idx), sizeof(usb_idx), 0);
	lwm2m_create_res_inst(&LWM2M_OBJ(3, 0, 7, 1));
	lwm2m_set_res_buf(&LWM2M_OBJ(3, 0, 7, 1), &usb_mv, sizeof(usb_mv), sizeof(usb_mv), 0);
	lwm2m_create_res_inst(&LWM2M_OBJ(3, 0, 8, 1));
	lwm2m_set_res_buf(&LWM2M_OBJ(3, 0, 8, 1), &usb_ma, sizeof(usb_ma), sizeof(usb_ma), 0);

	/* setup FIRMWARE object */
	if (IS_ENABLED(CONFIG_LWM2M_FIRMWARE_UPDATE_OBJ_SUPPORT)) {
		init_firmware_update(&client_ctx);
	}

	/* setup TEMP SENSOR object */
	init_temp_sensor(&client_ctx);

	/* setup TIME SERIES object */
	init_time_series_obj(&client_ctx);

	/* Set multiple TEMP SENSOR resource values in one function call. */
	int err = lwm2m_set_bulk(temp_sensor_items, ARRAY_SIZE(temp_sensor_items));

	if (err) {
		LOG_ERR("Failed to set TEMP SENSOR resources");
		return err;
	}

	/* IPSO: Light Control object */
	init_led_device();

	/* IPSO: Timer object */
	init_timer_object();

	return 0;
}

static void rd_client_event(struct lwm2m_ctx *client,
			    enum lwm2m_rd_client_event client_event)
{
	switch (client_event) {

	case LWM2M_RD_CLIENT_EVENT_NONE:
		/* do nothing */
		break;

	case LWM2M_RD_CLIENT_EVENT_SERVER_DISABLED:
		LOG_DBG("LwM2M server disabled");
		break;

	case LWM2M_RD_CLIENT_EVENT_BOOTSTRAP_REG_FAILURE:
		LOG_DBG("Bootstrap registration failure!");
		break;

	case LWM2M_RD_CLIENT_EVENT_BOOTSTRAP_REG_COMPLETE:
		LOG_DBG("Bootstrap registration complete");
		break;

	case LWM2M_RD_CLIENT_EVENT_BOOTSTRAP_TRANSFER_COMPLETE:
		LOG_DBG("Bootstrap transfer complete");
		break;

	case LWM2M_RD_CLIENT_EVENT_REGISTRATION_FAILURE:
		LOG_DBG("Registration failure!");
		break;

	case LWM2M_RD_CLIENT_EVENT_REGISTRATION_COMPLETE:
		LOG_DBG("Registration complete");
		break;

	case LWM2M_RD_CLIENT_EVENT_REG_TIMEOUT:
		LOG_DBG("Registration timeout!");
		break;

	case LWM2M_RD_CLIENT_EVENT_REG_UPDATE_COMPLETE:
		LOG_DBG("Registration update complete");
		break;

	case LWM2M_RD_CLIENT_EVENT_DEREGISTER_FAILURE:
		LOG_DBG("Deregister failure!");
		break;

	case LWM2M_RD_CLIENT_EVENT_DISCONNECT:
		LOG_DBG("Disconnected");
		break;

	case LWM2M_RD_CLIENT_EVENT_QUEUE_MODE_RX_OFF:
		LOG_DBG("Queue mode RX window closed");
		break;

	case LWM2M_RD_CLIENT_EVENT_ENGINE_SUSPENDED:
		LOG_DBG("LwM2M engine suspended");
		break;

	case LWM2M_RD_CLIENT_EVENT_NETWORK_ERROR:
		LOG_ERR("LwM2M engine reported a network error.");
		lwm2m_rd_client_stop(client, rd_client_event, true);
		break;

	case LWM2M_RD_CLIENT_EVENT_REG_UPDATE:
		LOG_DBG("Registration update");
		break;
	case LWM2M_RD_CLIENT_EVENT_DEREGISTER:
		LOG_DBG("Client De-register");
		break;
	}
}

static void socket_state(int fd, enum lwm2m_socket_states state)
{
	(void) fd;
	switch (state) {
	case LWM2M_SOCKET_STATE_ONGOING:
		LOG_DBG("LWM2M_SOCKET_STATE_ONGOING");
		break;
	case LWM2M_SOCKET_STATE_ONE_RESPONSE:
		LOG_DBG("LWM2M_SOCKET_STATE_ONE_RESPONSE");
		break;
	case LWM2M_SOCKET_STATE_LAST:
		LOG_DBG("LWM2M_SOCKET_STATE_LAST");
		break;
	case LWM2M_SOCKET_STATE_NO_DATA:
		LOG_DBG("LWM2M_SOCKET_STATE_NO_DATA");
		break;
	}
}

static void observe_cb(enum lwm2m_observe_event event,
		       struct lwm2m_obj_path *path, void *user_data)
{
	char buf[LWM2M_MAX_PATH_STR_SIZE];

	switch (event) {

	case LWM2M_OBSERVE_EVENT_OBSERVER_ADDED:
		LOG_INF("Observer added for %s", lwm2m_path_log_buf(buf, path));
		break;

	case LWM2M_OBSERVE_EVENT_OBSERVER_REMOVED:
		LOG_INF("Observer removed for %s", lwm2m_path_log_buf(buf, path));
		break;

	case LWM2M_OBSERVE_EVENT_NOTIFY_ACK:
		LOG_INF("Notify acknowledged for %s", lwm2m_path_log_buf(buf, path));
		break;

	case LWM2M_OBSERVE_EVENT_NOTIFY_TIMEOUT:
		LOG_INF("Notify timeout for %s, trying registration update",
			lwm2m_path_log_buf(buf, path));

		lwm2m_rd_client_update();
		break;
	}
}

static void on_net_event_l4_disconnected(void)
{
	LOG_INF("Disconnected from network");
	lwm2m_engine_pause();
}

static void on_net_event_l4_connected(void)
{
	LOG_INF("Connected to network");
	k_sem_give(&network_connected_sem);
	lwm2m_engine_resume();
}

static void l4_event_handler(struct net_mgmt_event_callback *cb,
			     uint64_t event,
			     struct net_if *iface)
{
	LOG_DBG("Event %llu", event);

	switch (event) {
	case NET_EVENT_L4_CONNECTED:
		LOG_INF("IP Up");
		on_net_event_l4_connected();
		break;
	case NET_EVENT_L4_DISCONNECTED:
		LOG_INF("IP down");
		on_net_event_l4_disconnected();
		break;
	default:
		break;
	}
}

static void connectivity_event_handler(struct net_mgmt_event_callback *cb,
				       uint64_t event,
				       struct net_if *iface)
{
	LOG_DBG("Event %llu", event);
	switch (event) {
		case NET_EVENT_CONN_IF_FATAL_ERROR:
			LOG_INF("Failed to connect to network");
			break;
		case NET_EVENT_WIFI_CONNECT_RESULT:
			if (cb == &wifi_conn_cb) {
				struct wifi_status *status = (struct wifi_status *)iface;
				if (status->status) {
					LOG_INF("Wi-Fi connected");
					k_sem_give(&network_connected_sem);
				} else {
					LOG_INF("Wi-Fi connection failed");
				}
			}
			break;
		default:
			break;
	}
}

int main(void)
{
	uint32_t flags = IS_ENABLED(CONFIG_LWM2M_RD_CLIENT_SUPPORT_BOOTSTRAP) ?
				LWM2M_RD_CLIENT_FLAG_BOOTSTRAP : 0;
	int ret;

	LOG_INF(APP_BANNER);

	k_sem_init(&quit_lock, 0, K_SEM_MAX_LIMIT);

	if (IS_ENABLED(CONFIG_NET_CONNECTION_MANAGER)) {
		/* Setup handler for Zephyr NET Connection Manager events. */
		net_mgmt_init_event_callback(&l4_cb, l4_event_handler, L4_EVENT_MASK);
		net_mgmt_add_event_callback(&l4_cb);

		/* Setup handler for Zephyr NET Connection Manager Connectivity layer. */
		net_mgmt_init_event_callback(&conn_cb, connectivity_event_handler,
					     CONN_LAYER_EVENT_MASK);
		net_mgmt_add_event_callback(&conn_cb);

		net_mgmt_init_event_callback(&wifi_conn_cb, connectivity_event_handler,
					     NET_EVENT_WIFI_CONNECT_RESULT);
		net_mgmt_add_event_callback(&wifi_conn_cb);

		ret = net_if_up(net_if_get_default());

		if (ret < 0 && ret != -EALREADY) {
			LOG_ERR("net_if_up, error: %d", ret);
			return ret;
		}

#if defined(CONFIG_WIFI) && (CONFIG_WIFI == 1)
		cnx_params = (struct wifi_connect_req_params) {
			.ssid = CONFIG_WIFI_SSID,
			.ssid_length = strlen(CONFIG_WIFI_SSID),
			.psk = CONFIG_WIFI_PSK,
			.psk_length = strlen(CONFIG_WIFI_PSK),
			.channel = 0,
			.security = WIFI_SECURITY_TYPE_PSK,
		};
		LOG_INF("Wi-Fi network <%s>", CONFIG_WIFI_SSID);
		ret = net_mgmt(NET_REQUEST_WIFI_CONNECT, net_if_get_default(),
			       &cnx_params,
			       sizeof(struct wifi_connect_req_params));
#else
		ret = conn_mgr_if_connect(net_if_get_default());
#endif
		/* Ignore errors from interfaces not requiring connectivity */
		if (ret == 0) {
			LOG_INF("Connecting to network");
			k_sem_take(&network_connected_sem, K_FOREVER);
		}
	}

	ret = lwm2m_setup();
	if (ret < 0) {
		LOG_ERR("Cannot setup LWM2M fields (%d)", ret);
		return 0;
	}

	(void)memset(&client_ctx, 0x0, sizeof(client_ctx));
#if defined(CONFIG_LWM2M_DTLS_SUPPORT)
	client_ctx.tls_tag = CONFIG_LWM2M_APP_TLS_TAG;
#endif
	client_ctx.set_socket_state = socket_state;

	/* client_ctx.sec_obj_inst is 0 as a starting point */
	lwm2m_rd_client_start(&client_ctx, endpoint, flags, rd_client_event, observe_cb);

	k_sem_take(&quit_lock, K_FOREVER);
	return 0;
}
```

## src/sensors.c
```c
/*
 * Copyright (c) 2026 Jonas Remmert
 *
 * SPDX-License-Identifier: Apache-2.0
 */

#include <string.h>

#include <zephyr/kernel.h>
#include <zephyr/logging/log.h>
#include <zephyr/net/lwm2m.h>

#include "app.h"

LOG_MODULE_REGISTER(app_sensors, LOG_LEVEL_INF);

#define SENSOR_VALUE_RID 5700
#define MIN_RANGE_RID 5603
#define MAX_RANGE_RID 5604
#define SENSOR_UNITS_RID 5701

struct sensor_obj {
	uint16_t obj_id;
	const char *units;
	double initial;
	double min_range;
	double max_range;
};

static struct sensor_obj sensors[] = {
	{IPSO_OBJECT_TEMP_SENSOR_ID, "Celsius", 20.0, -40.0, 125.0},
	{IPSO_OBJECT_HUMIDITY_SENSOR_ID, "%RH", 50.0, 0.0, 100.0},
};

int sensors_obj_init(void)
{
	ARRAY_FOR_EACH_PTR(sensors, s) {
		int ret = lwm2m_create_object_inst(&LWM2M_OBJ(s->obj_id, 0));

		if (ret < 0) {
			LOG_ERR("Cannot create object %u (%d)", s->obj_id, ret);
			return ret;
		}

		lwm2m_set_res_buf(&LWM2M_OBJ(s->obj_id, 0, SENSOR_UNITS_RID), (void *)s->units,
				  strlen(s->units) + 1, strlen(s->units) + 1,
				  LWM2M_RES_DATA_FLAG_RO);
		lwm2m_set_f64(&LWM2M_OBJ(s->obj_id, 0, MIN_RANGE_RID), s->min_range);
		lwm2m_set_f64(&LWM2M_OBJ(s->obj_id, 0, MAX_RANGE_RID), s->max_range);
		lwm2m_set_f64(&LWM2M_OBJ(s->obj_id, 0, SENSOR_VALUE_RID), s->initial);
	}

	return 0;
}
```

## src/shell.c
```c
/*
 * Copyright (c) 2026 Jonas Remmert
 *
 * SPDX-License-Identifier: Apache-2.0
 */

#include <stdlib.h>

#include <zephyr/net/conn_mgr_connectivity.h>
#include <zephyr/net/lwm2m.h>
#include <zephyr/net/net_if.h>
#include <zephyr/shell/shell.h>

#include "app.h"

static int cmd_start(const struct shell *sh, size_t argc, char **argv)
{
	const char *endpoint = argc > 1 ? argv[1] : CONFIG_LWM2M_APP_ID;
	int ret = 0;

	if (argc > 2) {
		ret = lwm2m_set_string(&LWM2M_OBJ(0, 0, 0), argv[2]);
	}
	if (ret == 0) {
		ret = app_lwm2m_start(endpoint);
	}
	if (ret < 0) {
		shell_error(sh, "start failed: %d", ret);
	}
	return ret;
}

static int cmd_net_up(const struct shell *sh, size_t argc, char **argv)
{
	int ret = conn_mgr_if_connect(net_if_get_default());

	if (ret < 0) {
		shell_error(sh, "net up failed: %d", ret);
	}
	return ret;
}

static int cmd_net_down(const struct shell *sh, size_t argc, char **argv)
{
	int ret = conn_mgr_if_disconnect(net_if_get_default());

	if (ret < 0) {
		shell_error(sh, "net down failed: %d", ret);
	}
	return ret;
}

static int fota_cmd(const struct shell *sh, const char *arg, unsigned long max,
		    int (*set)(uint8_t))
{
	char *end;
	unsigned long value = strtoul(arg, &end, 10);
	int ret;

	if (*end != '\0' || value > max) {
		shell_error(sh, "invalid value: %s", arg);
		return -EINVAL;
	}

	ret = set(value);
	if (ret < 0) {
		shell_error(sh, "report failed: %d", ret);
	}
	return ret;
}

static int cmd_fota_state(const struct shell *sh, size_t argc, char **argv)
{
	return fota_cmd(sh, argv[1], STATE_UPDATING, fota_set_state);
}

static int cmd_fota_result(const struct shell *sh, size_t argc, char **argv)
{
	return fota_cmd(sh, argv[1], RESULT_UNSUP_PROTO, fota_set_result);
}

SHELL_STATIC_SUBCMD_SET_CREATE(sub_net,
	SHELL_CMD_ARG(up, NULL, "Connect the default interface", cmd_net_up, 1, 0),
	SHELL_CMD_ARG(down, NULL, "Disconnect the default interface", cmd_net_down, 1, 0),
	SHELL_SUBCMD_SET_END);

SHELL_STATIC_SUBCMD_SET_CREATE(sub_fota,
	SHELL_CMD_ARG(state, NULL, "state <0-3>\nSet and send Firmware Update state 5/0/3",
		      cmd_fota_state, 2, 0),
	SHELL_CMD_ARG(result, NULL, "result <0-9>\nSet and send update result 5/0/5",
		      cmd_fota_result, 2, 0),
	SHELL_SUBCMD_SET_END);

SHELL_STATIC_SUBCMD_SET_CREATE(sub_flownexus,
	SHELL_CMD_ARG(start, NULL, "start [endpoint [server-uri]]\nStart the RD client",
		      cmd_start, 1, 2),
	SHELL_CMD(net, &sub_net, "Simulate network loss and recovery", NULL),
	SHELL_CMD(fota, &sub_fota, "Simulate a firmware update", NULL),
	SHELL_SUBCMD_SET_END);

SHELL_CMD_REGISTER(flownexus, &sub_flownexus, "Flownexus client commands", NULL);
```

## src/temperature.c
```c
/*
 * Copyright (c) 2022 Nordic Semiconductor
 *
 * SPDX-License-Identifier: Apache-2.0
 */

#define LOG_MODULE_NAME app_temp
#include <zephyr/logging/log.h>
LOG_MODULE_REGISTER(LOG_MODULE_NAME);

#include "modules.h"

#include <zephyr/drivers/hwinfo.h>
#include <zephyr/drivers/sensor.h>
#include <zephyr/net/lwm2m.h>
#include <zephyr/kernel.h>
#include <zephyr/random/random.h>
#include <stdint.h>

static struct k_work_delayable temp_work;
#define PERIOD K_SECONDS(10)

static struct lwm2m_ctx *client_ctx;

static void temp_work_cb(struct k_work *work)
{
	double t, h;
	int ret;

	if (IS_ENABLED(CONFIG_SHT4X)) {
		const struct device *dev = DEVICE_DT_GET_ANY(sensirion_sht4x);
		struct sensor_value val;

		if (!dev) {
			LOG_ERR("device not ready.");
			goto out;
		}
		if (sensor_sample_fetch(dev)) {
			LOG_ERR("temperature data update failed");
			goto out;
		}

		sensor_channel_get(dev, SENSOR_CHAN_AMBIENT_TEMP, &val);
		t = sensor_value_to_double(&val);
		sensor_channel_get(dev, SENSOR_CHAN_HUMIDITY, &val);
		h = sensor_value_to_double(&val);
		LOG_DBG("Temperature: %.2f, Humidity: %.2f", t, h);

	} else {
		/* Generate dummy temperature data */
		t = 20.0 + (double)sys_rand32_get() / UINT32_MAX * 5.0;
		h = 50.0 + (double)sys_rand32_get() / UINT32_MAX * 10.0;
	}

	lwm2m_set_f64(&LWM2M_OBJ(3303, 0, 5700), t);
	lwm2m_set_f64(&LWM2M_OBJ(3304, 0, 5700), h);

	ret = lwm2m_send_cb(client_ctx, &LWM2M_OBJ(3303, 0, 5700), 1, NULL);
	if (ret) {
		LOG_ERR("lwm2m_send_cb, error: %d", ret);
	}
	ret = lwm2m_send_cb(client_ctx, &LWM2M_OBJ(3304, 0, 5700), 1, NULL);
	if (ret) {
		LOG_ERR("lwm2m_send_cb, error: %d", ret);
	}

	/* As an alternative, you can send the values together. In that case
	 * flownexus assigns them to an event. The name of the event is the
	 * first object (3303 in this case).
	 *
	 * const struct lwm2m_obj_path path[2] = {
	 * 	LWM2M_OBJ(3303, 0, 5700),
	 * 	LWM2M_OBJ(3304, 0, 5700),
	 * };
	 * ret = lwm2m_send_cb(client_ctx, path, 2, NULL);
	 * if (ret) {
	 * 	LOG_ERR("lwm2m_send_cb, error: %d", ret);
	 * }
	 */

out:
	k_work_schedule(&temp_work, PERIOD);
}

void init_temp_sensor(struct lwm2m_ctx *client)
{
	client_ctx = client;

	if ((lwm2m_create_object_inst(&LWM2M_OBJ(3303, 0)) == 0) &&
	    (lwm2m_create_object_inst(&LWM2M_OBJ(3304, 0)) == 0)) {
		k_work_init_delayable(&temp_work, temp_work_cb);
		k_work_schedule(&temp_work, K_NO_WAIT);
	} else {
		LOG_ERR("Failed to create temperature object instance");
	}
}
```

## src/time_series_object.c
```c
/*
 * Copyright (c) 2024 Jonas Remmert
 *
 * SPDX-License-Identifier: Apache-2.0
 */

#define LOG_MODULE_NAME app_time_series_obj
#include <zephyr/logging/log.h>
LOG_MODULE_REGISTER(LOG_MODULE_NAME);

#include "modules.h"
#include <lwm2m_object.h>
#include <lwm2m_engine.h>
#include <zephyr/net/lwm2m.h>

#define N_SAMPLES	40
#define PERIOD		K_SECONDS(1)

#define TIME_SERIES_VERSION_MAJOR	1
#define TIME_SERIES_VERSION_MINOR	0
#define LWM2M_TIME_SERIES_ID		10300
#define LWM2M_TIME_SERIES_RAW_ID	0
#define TIME_SERIES_MAX_ID		1
/*
 * Calculate resource instances as follows:
 * start with EVENT_LOG_MAX_ID
 * subtract EXEC resources (0)
 */
#define RESOURCE_INSTANCE_COUNT (TIME_SERIES_MAX_ID - 0)

static struct k_work_delayable time_series_work;

static struct lwm2m_ctx *client_ctx;

/* resource state variables */
static uint8_t time_series_raw;
/* Allocate data cache storage */
static struct lwm2m_time_series_elem time_series_cache[N_SAMPLES];

static struct lwm2m_engine_obj lwm2m_time_series_obj;
static struct lwm2m_engine_obj_field fields[] = {
	OBJ_FIELD_DATA(LWM2M_TIME_SERIES_RAW_ID, R, U8),
};

static struct lwm2m_engine_obj_inst inst;
static struct lwm2m_engine_res res[TIME_SERIES_MAX_ID];
static struct lwm2m_engine_res_inst res_inst[RESOURCE_INSTANCE_COUNT];


void time_series_send_cb(enum lwm2m_send_status status)
{
	if (status == 0) {
		LOG_INF("Time series data sent successfully");
	} else {
		LOG_ERR("Time series data send failed");
	}

	/* Once the previous message is out, add new data */
	k_work_schedule(&time_series_work, PERIOD);
}

static void time_series_work_cb(struct k_work *work)
{
	int ret;
	static int sample;

	/* Assign a test payload that counts from 1 - N_SAMPLES */
	lwm2m_set_u8(&LWM2M_OBJ(LWM2M_TIME_SERIES_ID, 0,
				LWM2M_TIME_SERIES_RAW_ID), sample);
	if (sample < N_SAMPLES) {
		sample++;
		k_work_schedule(&time_series_work, PERIOD);
		LOG_INF("Sample: %d/%d", sample, N_SAMPLES);
		return;
	}

	LOG_INF("Sending time series data");
	ret = lwm2m_send_cb(client_ctx, &LWM2M_OBJ(LWM2M_TIME_SERIES_ID, 0,
						   LWM2M_TIME_SERIES_RAW_ID), 1,
			    time_series_send_cb);
	if (ret) {
		LOG_ERR("lwm2m_send_cb, error: %d", ret);
	}
	sample = 0;
}

static struct lwm2m_engine_obj_inst *lwm2m_time_series_obj_create(uint16_t obj_inst_id)
{
	int i = 0, j = 0;

	init_res_instance(res_inst, ARRAY_SIZE(res_inst));

	/* initialize instance resource data */
	INIT_OBJ_RES_DATA(LWM2M_TIME_SERIES_RAW_ID, res, i, res_inst, j,
			  &time_series_raw, sizeof(time_series_raw));

	inst.resources = res;
	inst.resource_count = i;

	LOG_INF("Created LwM2M Time Series instance: %d", obj_inst_id);
	return &inst;
}

void init_time_series_obj(struct lwm2m_ctx *client)
{
	client_ctx = client;
	struct lwm2m_engine_obj_inst *obj_inst = NULL;
	int ret = 0;

	/* initialize the Event Log field data */
	lwm2m_time_series_obj.obj_id = LWM2M_TIME_SERIES_ID;
	lwm2m_time_series_obj.version_major = TIME_SERIES_VERSION_MAJOR;
	lwm2m_time_series_obj.version_minor = TIME_SERIES_VERSION_MINOR;
	lwm2m_time_series_obj.is_core = false;
	lwm2m_time_series_obj.fields = fields;
	lwm2m_time_series_obj.field_count = ARRAY_SIZE(fields);
	lwm2m_time_series_obj.max_instance_count = 1U;
	lwm2m_time_series_obj.create_cb = lwm2m_time_series_obj_create;
	lwm2m_register_obj(&lwm2m_time_series_obj);

	/* auto create the first instance */
	ret = lwm2m_create_obj_inst(LWM2M_TIME_SERIES_ID, 0, &obj_inst);
	if (ret < 0) {
		LOG_ERR("Create LWM2M Pump Mon instance 0 error: %d", ret);
	}

	ret = lwm2m_enable_cache(&LWM2M_OBJ(LWM2M_TIME_SERIES_ID, 0, LWM2M_TIME_SERIES_RAW_ID),
				 time_series_cache, ARRAY_SIZE(time_series_cache));
	if (ret < 0) {
		LOG_ERR("Failed to enable cache for LWM2M Pump Mon instance 0: %d", ret);
	}

	//k_work_init_delayable(&time_series_work, time_series_work_cb);
	//k_work_schedule(&time_series_work, PERIOD);
}
```
